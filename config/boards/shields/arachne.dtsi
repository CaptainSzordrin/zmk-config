#include <dt-bindings/zmk/matrix_transform.h>

/ {
    chosen {
        zmk,kscan = &kscan0;
        zmk,matrix-transform = &default_transform;
    };

    default_transform: keymap_transform_0 {
        compatible = "zmk,matrix-transform";
        columns = <6>; // Number of physical columns on one side
        rows = <10>;   // Combined rows for BOTH sides together
        
        map = <
            // Your key grid positions go here
        >;
    };

    kscan0: kscan_0 {
        compatible = "zmk,kscan-gpio-matrix";
        label = "KSCAN";
        diode-direction = "col2row"; 

        col-gpios
            = <&pro_micro 10 GPIO_ACTIVE_HIGH>
            // Add the rest of your column pins here
            ;

        row-gpios
            = <&pro_micro 4 (GPIO_ACTIVE_HIGH | GPIO_PULL_DOWN)>
            // Add the rest of your row pins here
            ;
    };
};