#include "arachne.dtsi"

&default_transform {
    col-offset = <6>;
};

/ {
    kscan0: kscan {
        compatible = "zmk,kscan-gpio-matrix";
        diode-direction = "col2row";

   
            ;

     
    };
};