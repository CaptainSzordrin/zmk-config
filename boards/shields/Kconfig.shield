## config/boards/shields/Kconfig.shield
```kconfig
config SHIELD_ARACHNE_LEFT
    def_bool $(shields_list_contains,arachne_left)

config SHIELD_ARACHNE_RIGHT
    def_bool $(shields_list_contains,arachne_right)
```

## config/boards/shields/arachne/Kconfig.defconfig
```kconfig
if SHIELD_ARACHNE_LEFT || SHIELD_ARACHNE_RIGHT

config ZMK_KEYBOARD_NAME
    default "Arachne"

config ZMK_SPLIT
    default y

endif
```
